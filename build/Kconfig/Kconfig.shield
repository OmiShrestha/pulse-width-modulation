## build/Kconfig/Kconfig.shield
```kconfig
osource "/Users/theomigod/others/pwm/boards/shields/*/Kconfig.shield"
osource "/Users/theomigod/pwm/boards/shields/*/Kconfig.shield"
osource "/opt/nordic/ncs/v2.9.0/nrf/boards/shields/*/Kconfig.shield"
```

## build/Kconfig/boards/Kconfig.nrf52833dk
```kconfig
# Load board Kconfig descriptions.
osource "/opt/nordic/ncs/v2.9.0/zephyr/boards/nordic/nrf52833dk/Kconfig.nrf52833dk"
```

## build/pwm/Kconfig/Kconfig.shield.defconfig
```kconfig
osource "/Users/theomigod/others/pwm/boards/shields/*/Kconfig.defconfig"
osource "/Users/theomigod/pwm/boards/shields/*/Kconfig.defconfig"
osource "/opt/nordic/ncs/v2.9.0/nrf/boards/shields/*/Kconfig.defconfig"
```
